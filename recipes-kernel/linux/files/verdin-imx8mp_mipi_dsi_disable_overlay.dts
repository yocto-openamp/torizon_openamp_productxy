// SPDX-License-Identifier: GPL-2.0-or-later OR MIT
/dts-v1/;
/plugin/;

/ {
	compatible = "toradex,verdin-imx8mp";
};

/* Disable MIPI DSI controller and display drivers */
&mipi_dsi {
	status = "disabled";
};
